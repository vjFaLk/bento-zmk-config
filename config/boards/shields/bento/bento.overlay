/*
 * Copyright (c) 2021 Dan Thomas
 *
 * SPDX-License-Identifier: MIT
 */

/ {
    chosen {
        zmk,kscan = &kscan0;
    };

    kscan0: kscan_0 {
        compatible = "zmk,kscan-gpio-direct";
        label = "KSCAN";

        input-gpios
            = <&pro_micro_d 0 (GPIO_ACTIVE_LOW | GPIO_PULL_UP)>
            , <&pro_micro_d 4 (GPIO_ACTIVE_LOW | GPIO_PULL_UP)>
            , <&pro_micro_a 3 (GPIO_ACTIVE_LOW | GPIO_PULL_UP)>

            , <&pro_micro_d 6 (GPIO_ACTIVE_LOW | GPIO_PULL_UP)>
            , <&pro_micro_d 15 (GPIO_ACTIVE_LOW | GPIO_PULL_UP)>
            , <&pro_micro_d 14 (GPIO_ACTIVE_LOW | GPIO_PULL_UP)>
            ;
    };

    encoder_1: encoder_1 {
		compatible = "alps,ec11";
		label = "Encoder 1";
		a-gpios = <&pro_micro_d 2 (GPIO_ACTIVE_LOW | GPIO_PULL_UP)>;
		b-gpios = <&pro_micro_d 20 (GPIO_ACTIVE_LOW | GPIO_PULL_UP)>;
		resolution = <4>;
		status = "disabled";
	};
};
